## target/linux/generic/files/drivers/platform/mikrotik/Kconfig
```kconfig
menuconfig MIKROTIK
	bool "Platform support for MikroTik RouterBoard virtual devices"
	default n
	help
	  Say Y here to get to see options for the MikroTik RouterBoard platform.
	  This option alone does not add any kernel code.


if MIKROTIK

config MIKROTIK_RB_SYSFS
	tristate "RouterBoot sysfs support"
	depends on MTD
	select LZO_DECOMPRESS
	select CRC32
	help
	  This driver exposes RouterBoot configuration in sysfs.

config MIKROTIK_RB_64K_SOFT_CONF
	tristate "RouterBoot soft_config 64k mtd write support"
	depends on MIKROTIK_RB_SYSFS
	help
	  Enable write access to soft-config 64k mtd(without need of 4K sectors)

config MIKROTIK_ATH79_RB_64K_SOFT_CONF
	tristate "RouterBoot soft_config 64k mtd write support for ath79 platform"
	depends on MIKROTIK_RB_SYSFS && ATH79
	help
	  Enable write access to soft-config 64k mtd(without need of 4K sectors)
	  on ath79 platform(by using sc_erase mtd)

endif # MIKROTIK
```
